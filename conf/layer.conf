## conf/layer.conf
```bitbake
# We have a conf and classes directory, add to BBPATH
BBPATH .= ":${LAYERDIR}"

# We have recipes-* directories, add to BBFILES
BBFILES += "${LAYERDIR}/recipes-*/*/*.bb \
            ${LAYERDIR}/recipes-*/*/*.bbappend"

BBFILE_COLLECTIONS += "meta-pybluetooth"
BBFILE_PATTERN_meta-pybluetooth = "^${LAYERDIR}/"
BBFILE_PRIORITY_meta-pybluetooth = "6"

LAYERDEPENDS_meta-pybluetooth = "core"
LAYERSERIES_COMPAT_meta-pybluetooth = "dunfell gatesgarth hardknott"
```
